## package/ipctool/Config.in
```kconfig
config BR2_PACKAGE_IPCTOOL
	bool "ipctool"
	depends on BR2_SOC_SIGMASTAR
	help
	  OpenIPC's IP-camera hardware identification tool. Installs
	  `ipcinfo`, which reports the SoC, the flash chip and -- the reason
	  this board wants it -- the sensor actually attached, probed over
	  i2c rather than read from a stored variable.

	  load_sigmastar falls back to `ipcinfo -s` when the U-Boot `sensor`
	  variable is unset, which is what makes one image work on any board
	  of this model instead of only on boards whose OEM set the variable.

	  https://github.com/openipc/ipctool
```

## package/sigmastar-osdrv-infinity6b0/Config.in
```kconfig
config BR2_PACKAGE_SIGMASTAR_OSDRV_INFINITY6B0
	bool "sigmastar-osdrv-infinity6b0"
	depends on BR2_SOC_SIGMASTAR
	select BR2_PACKAGE_SIGMASTAR_OSDRV_SENSORS
	help
	  SigmaStar Infinity6B0 vendor MI driver bundle: the mi_* kernel
	  modules, the MI userspace libraries, the ISP firmware, and the
	  per-sensor ISP tuning blobs.

	  Ported from OpenIPC's package of the same name. The .ko files are
	  the vendor's, built against Linux 4.9.84, which is why this board
	  pins that kernel: insmod checks vermagic and a mismatch is fatal.

	  https://github.com/openipc/firmware

config BR2_PACKAGE_SIGMASTAR_OSDRV_INFINITY6B0_SENSORS
	string "sensor tuning blobs to install"
	default ""
	depends on BR2_PACKAGE_SIGMASTAR_OSDRV_INFINITY6B0
	help
	  Space-separated list of sensor names whose ISP tuning blobs are
	  installed, without the .bin suffix -- for example "sc3336" or
	  "sc3336 sc3338". Leave empty to install all of them, which is the
	  right answer whenever the flash can afford it.

	  Narrowing this makes the image board-specific rather than
	  SoC-specific: load_sigmastar probes i2c and binds whichever sensor
	  it finds, so a blob that is not installed is a board the image
	  cannot drive. Only set it when the part is too small to hold the
	  full set, and say in the camera defconfig which board it was cut
	  for.

	  The full set is roughly 1.5MB raw. What that costs compressed
	  depends on how well the blobs dedupe against each other.
```

## package/sigmastar-osdrv-infinity6e/Config.in
```kconfig
config BR2_PACKAGE_SIGMASTAR_OSDRV_INFINITY6E
	bool "sigmastar-osdrv-infinity6e"
	depends on BR2_SOC_VENDOR_SIGMASTAR
	select BR2_PACKAGE_SIGMASTAR_OSDRV_SENSORS
	help
	  SigmaStar Infinity6E vendor MI driver bundle: the mi_* kernel
	  modules, the MI userspace libraries the Raptor HAL dlopens, the
	  ISP firmware, and the per-sensor ISP tuning blobs.

	  Ported from OpenIPC's package of the same name. The .ko files are
	  the vendor's, built against Linux 4.9.84, which is why this board
	  pins that kernel: insmod checks vermagic and a mismatch is fatal.

	  https://github.com/openipc/firmware
```

## package/sigmastar-osdrv-sensors/Config.in
```kconfig
config BR2_PACKAGE_SIGMASTAR_OSDRV_SENSORS
	bool "sigmastar-osdrv-sensors"
	depends on BR2_SOC_VENDOR_SIGMASTAR
	depends on BR2_LINUX_KERNEL
	help
	  SigmaStar sensor driver kernel modules, built from source for the
	  configured Infinity family.

	  Produces one sensor_<model>_mipi.ko per supported sensor, plus
	  sensor_config.ko, which exposes the i2c probe over /dev/srcfg.
	  All are installed; load_sigmastar picks one at runtime from the
	  U-Boot `sensor` variable. Nothing loads sensor_config.ko now that
	  ipctool is gone -- it is what a native SigmaStar detector would
	  drive.

	  https://github.com/openipc/sensors
```
